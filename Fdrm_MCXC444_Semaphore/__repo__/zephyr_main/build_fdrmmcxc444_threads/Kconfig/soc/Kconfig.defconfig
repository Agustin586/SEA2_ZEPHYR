## Fdrm_MCXC444_Semaphore/debug/Kconfig/Kconfig.sysbuild.modules
```kconfig
config ZEPHYR_ZSDK_MODULE
   bool
   default y
config ZEPHYR_HAL_NXP_MODULE
   bool
   default y
config ZEPHYR_ELS_PKC_MODULE
   bool
   default y
config ZEPHYR_PSA_CRYPTO_DRIVER_MODULE
   bool
   default y
config ZEPHYR_MBEDTLS_MODULE
   bool
   default y
config ZEPHYR_TRUSTED_FIRMWARE_M_MODULE
   bool
   default y
config ZEPHYR_PSA_ARCH_TESTS_MODULE
   bool
   default y
config ZEPHYR_TF_M_TESTS_MODULE
   bool
   default y
config ZEPHYR_HOSTAP_MODULE
   bool
   default y
config ZEPHYR_NXP_IOT_AGENT_MODULE
   bool
   default y
config ZEPHYR_CANOPENNODE_MODULE
   bool
   default y
config ZEPHYR_CHRE_MODULE
   bool
   default y
config ZEPHYR_LZ4_MODULE
   bool
   default y
config ZEPHYR_ZSCILIB_MODULE
   bool
   default y
config ZEPHYR_CMSIS_MODULE
   bool
   default y
config ZEPHYR_CMSIS_DSP_MODULE
   bool
   default y
config ZEPHYR_CMSIS_NN_MODULE
   bool
   default y
config ZEPHYR_CMSIS_6_MODULE
   bool
   default y
config ZEPHYR_FATFS_MODULE
   bool
   default y
config ZEPHYR_HAL_ST_MODULE
   bool
   default y
config ZEPHYR_XTENSA_MODULE
   bool
   default y
config ZEPHYR_LIBLC3_MODULE
   bool
   default y
config ZEPHYR_LIBMETAL_MODULE
   bool
   default y
config ZEPHYR_LITTLEFS_MODULE
   bool
   default y
config ZEPHYR_LORAMAC_NODE_MODULE
   bool
   default y
config ZEPHYR_LVGL_MODULE
   bool
   default y
config ZEPHYR_MCUBOOT_MODULE
   bool
   default y
config ZEPHYR_MIPI_SYS_T_MODULE
   bool
   default y
config ZEPHYR_OPEN_AMP_MODULE
   bool
   default y
config ZEPHYR_OPENTHREAD_MODULE
   bool
   default y
config ZEPHYR_PICOLIBC_MODULE
   bool
   default y
config ZEPHYR_SEGGER_MODULE
   bool
   default y
config ZEPHYR_TINYCRYPT_MODULE
   bool
   default y
config ZEPHYR_UOSCORE_UEDHOC_MODULE
   bool
   default y
config ZEPHYR_ZCBOR_MODULE
   bool
   default y
```

## Fdrm_MCXC444_Semaphore/debug/Kconfig/arch/Kconfig
```kconfig
# Load Zephyr Arch Kconfig descriptions.
osource "D:/aguat/Documents/zephyr/zephyr_main/zephyr_main/zephyr_main/zephyr/arch/rx/Kconfig"
osource "D:/aguat/Documents/zephyr/zephyr_main/zephyr_main/zephyr_main/zephyr/arch/x86/Kconfig"
osource "D:/aguat/Documents/zephyr/zephyr_main/zephyr_main/zephyr_main/zephyr/arch/xtensa/Kconfig"
osource "D:/aguat/Documents/zephyr/zephyr_main/zephyr_main/zephyr_main/zephyr/arch/sparc/Kconfig"
osource "D:/aguat/Documents/zephyr/zephyr_main/zephyr_main/zephyr_main/zephyr/arch/riscv/Kconfig"
osource "D:/aguat/Documents/zephyr/zephyr_main/zephyr_main/zephyr_main/zephyr/arch/posix/Kconfig"
osource "D:/aguat/Documents/zephyr/zephyr_main/zephyr_main/zephyr_main/zephyr/arch/mips/Kconfig"
osource "D:/aguat/Documents/zephyr/zephyr_main/zephyr_main/zephyr_main/zephyr/arch/arm64/Kconfig"
osource "D:/aguat/Documents/zephyr/zephyr_main/zephyr_main/zephyr_main/zephyr/arch/arm/Kconfig"
osource "D:/aguat/Documents/zephyr/zephyr_main/zephyr_main/zephyr_main/zephyr/arch/arc/Kconfig"
```

## Fdrm_MCXC444_Semaphore/debug/Kconfig/soc/Kconfig.sysbuild
```kconfig
# Load Sysbuild SoC Kconfig descriptions.
osource "D:/aguat/Documents/zephyr/zephyr_main/zephyr_main/zephyr_main/zephyr/soc/xlnx/zynqmp/Kconfig.sysbuild"
osource "D:/aguat/Documents/zephyr/zephyr_main/zephyr_main/zephyr_main/zephyr/soc/xlnx/zynq7000/Kconfig.sysbuild"
osource "D:/aguat/Documents/zephyr/zephyr_main/zephyr_main/zephyr_main/zephyr/soc/xlnx/versalnet/Kconfig.sysbuild"
osource "D:/aguat/Documents/zephyr/zephyr_main/zephyr_main/zephyr_main/zephyr/soc/xlnx/versal2/Kconfig.sysbuild"
osource "D:/aguat/Documents/zephyr/zephyr_main/zephyr_main/zephyr_main/zephyr/soc/xen/Kconfig.sysbuild"
osource "D:/aguat/Documents/zephyr/zephyr_main/zephyr_main/zephyr_main/zephyr/soc/wch/ch32v/Kconfig.sysbuild"
osource "D:/aguat/Documents/zephyr/zephyr_main/zephyr_main/zephyr_main/zephyr/soc/ti/simplelink/Kconfig.sysbuild"
osource "D:/aguat/Documents/zephyr/zephyr_main/zephyr_main/zephyr_main/zephyr/soc/ti/mspm0/Kconfig.sysbuild"
osource "D:/aguat/Documents/zephyr/zephyr_main/zephyr_main/zephyr_main/zephyr/soc/ti/lm3s6965/Kconfig.sysbuild"
osource "D:/aguat/Documents/zephyr/zephyr_main/zephyr_main/zephyr_main/zephyr/soc/ti/k3/Kconfig.sysbuild"
osource "D:/aguat/Documents/zephyr/zephyr_main/zephyr_main/zephyr_main/zephyr/soc/telink/tlsr/Kconfig.sysbuild"
osource "D:/aguat/Documents/zephyr/zephyr_main/zephyr_main/zephyr_main/zephyr/soc/starfive/jh71xx/Kconfig.sysbuild"
osource "D:/aguat/Documents/zephyr/zephyr_main/zephyr_main/zephyr_main/zephyr/soc/st/stm32/Kconfig.sysbuild"
osource "D:/aguat/Documents/zephyr/zephyr_main/zephyr_main/zephyr_main/zephyr/soc/snps/qemu_arc/Kconfig.sysbuild"
osource "D:/aguat/Documents/zephyr/zephyr_main/zephyr_main/zephyr_main/zephyr/soc/snps/nsim/arc_v/Kconfig.sysbuild"
osource "D:/aguat/Documents/zephyr/zephyr_main/zephyr_main/zephyr_main/zephyr/soc/snps/nsim/arc_classic/Kconfig.sysbuild"
osource "D:/aguat/Documents/zephyr/zephyr_main/zephyr_main/zephyr_main/zephyr/soc/snps/hsdk4xd/Kconfig.sysbuild"
osource "D:/aguat/Documents/zephyr/zephyr_main/zephyr_main/zephyr_main/zephyr/soc/snps/hsdk/Kconfig.sysbuild"
osource "D:/aguat/Documents/zephyr/zephyr_main/zephyr_main/zephyr_main/zephyr/soc/snps/emsk/Kconfig.sysbuild"
osource "D:/aguat/Documents/zephyr/zephyr_main/zephyr_main/zephyr_main/zephyr/soc/snps/emsdp/Kconfig.sysbuild"
osource "D:/aguat/Documents/zephyr/zephyr_main/zephyr_main/zephyr_main/zephyr/soc/snps/arc_iot/Kconfig.sysbuild"
osource "D:/aguat/Documents/zephyr/zephyr_main/zephyr_main/zephyr_main/zephyr/soc/silabs/Kconfig.sysbuild"
osource "D:/aguat/Documents/zephyr/zephyr_main/zephyr_main/zephyr_main/zephyr/soc/sifli/sf32/Kconfig.sysbuild"
osource "D:/aguat/Documents/zephyr/zephyr_main/zephyr_main/zephyr_main/zephyr/soc/sifive/sifive_freedom/Kconfig.sysbuild"
osource "D:/aguat/Documents/zephyr/zephyr_main/zephyr_main/zephyr_main/zephyr/soc/sensry/Kconfig.sysbuild"
osource "D:/aguat/Documents/zephyr/zephyr_main/zephyr_main/zephyr_main/zephyr/soc/rockchip/Kconfig.sysbuild"
osource "D:/aguat/Documents/zephyr/zephyr_main/zephyr_main/zephyr_main/zephyr/soc/renode/riscv_virtual/Kconfig.sysbuild"
osource "D:/aguat/Documents/zephyr/zephyr_main/zephyr_main/zephyr_main/zephyr/soc/renode/cortex_r8_virtual/Kconfig.sysbuild"
osource "D:/aguat/Documents/zephyr/zephyr_main/zephyr_main/zephyr_main/zephyr/soc/renesas/smartbond/Kconfig.sysbuild"
osource "D:/aguat/Documents/zephyr/zephyr_main/zephyr_main/zephyr_main/zephyr/soc/renesas/rz/Kconfig.sysbuild"
osource "D:/aguat/Documents/zephyr/zephyr_main/zephyr_main/zephyr_main/zephyr/soc/renesas/rx/Kconfig.sysbuild"
osource "D:/aguat/Documents/zephyr/zephyr_main/zephyr_main/zephyr_main/zephyr/soc/renesas/rcar/Kconfig.sysbuild"
osource "D:/aguat/Documents/zephyr/zephyr_main/zephyr_main/zephyr_main/zephyr/soc/renesas/ra/Kconfig.sysbuild"
osource "D:/aguat/Documents/zephyr/zephyr_main/zephyr_main/zephyr_main/zephyr/soc/realtek/ec/Kconfig.sysbuild"
osource "D:/aguat/Documents/zephyr/zephyr_main/zephyr_main/zephyr_main/zephyr/soc/raspberrypi/rpi_pico/Kconfig.sysbuild"
osource "D:/aguat/Documents/zephyr/zephyr_main/zephyr_main/zephyr_main/zephyr/soc/quicklogic/eos_s3/Kconfig.sysbuild"
osource "D:/aguat/Documents/zephyr/zephyr_main/zephyr_main/zephyr_main/zephyr/soc/qemu/virt_riscv/Kconfig.sysbuild"
osource "D:/aguat/Documents/zephyr/zephyr_main/zephyr_main/zephyr_main/zephyr/soc/qemu/malta/Kconfig.sysbuild"
osource "D:/aguat/Documents/zephyr/zephyr_main/zephyr_main/zephyr_main/zephyr/soc/openisa/rv32m1/Kconfig.sysbuild"
osource "D:/aguat/Documents/zephyr/zephyr_main/zephyr_main/zephyr_main/zephyr/soc/openhwgroup/cva6/Kconfig.sysbuild"
osource "D:/aguat/Documents/zephyr/zephyr_main/zephyr_main/zephyr_main/zephyr/soc/oct/osd32mp15x/Kconfig.sysbuild"
osource "D:/aguat/Documents/zephyr/zephyr_main/zephyr_main/zephyr_main/zephyr/soc/nxp/s32/Kconfig.sysbuild"
osource "D:/aguat/Documents/zephyr/zephyr_main/zephyr_main/zephyr_main/zephyr/soc/nxp/rw/Kconfig.sysbuild"
osource "D:/aguat/Documents/zephyr/zephyr_main/zephyr_main/zephyr_main/zephyr/soc/nxp/mcx/Kconfig.sysbuild"
osource "D:/aguat/Documents/zephyr/zephyr_main/zephyr_main/zephyr_main/zephyr/soc/nxp/lpc/Kconfig.sysbuild"
osource "D:/aguat/Documents/zephyr/zephyr_main/zephyr_main/zephyr_main/zephyr/soc/nxp/layerscape/Kconfig.sysbuild"
osource "D:/aguat/Documents/zephyr/zephyr_main/zephyr_main/zephyr_main/zephyr/soc/nxp/kinetis/Kconfig.sysbuild"
osource "D:/aguat/Documents/zephyr/zephyr_main/zephyr_main/zephyr_main/zephyr/soc/nxp/imxrt/Kconfig.sysbuild"
osource "D:/aguat/Documents/zephyr/zephyr_main/zephyr_main/zephyr_main/zephyr/soc/nxp/imx/Kconfig.sysbuild"
osource "D:/aguat/Documents/zephyr/zephyr_main/zephyr_main/zephyr_main/zephyr/soc/nuvoton/numicro/Kconfig.sysbuild"
osource "D:/aguat/Documents/zephyr/zephyr_main/zephyr_main/zephyr_main/zephyr/soc/nuvoton/numaker/Kconfig.sysbuild"
osource "D:/aguat/Documents/zephyr/zephyr_main/zephyr_main/zephyr_main/zephyr/soc/nuvoton/npcx/Kconfig.sysbuild"
osource "D:/aguat/Documents/zephyr/zephyr_main/zephyr_main/zephyr_main/zephyr/soc/nuvoton/npcm/Kconfig.sysbuild"
osource "D:/aguat/Documents/zephyr/zephyr_main/zephyr_main/zephyr_main/zephyr/soc/nordic/Kconfig.sysbuild"
osource "D:/aguat/Documents/zephyr/zephyr_main/zephyr_main/zephyr_main/zephyr/soc/neorv32/Kconfig.sysbuild"
osource "D:/aguat/Documents/zephyr/zephyr_main/zephyr_main/zephyr_main/zephyr/soc/native/inf_clock/Kconfig.sysbuild"
osource "D:/aguat/Documents/zephyr/zephyr_main/zephyr_main/zephyr_main/zephyr/soc/microchip/sam/Kconfig.sysbuild"
osource "D:/aguat/Documents/zephyr/zephyr_main/zephyr_main/zephyr_main/zephyr/soc/microchip/sam/sam_d5x_e5x/Kconfig.sysbuild"
osource "D:/aguat/Documents/zephyr/zephyr_main/zephyr_main/zephyr_main/zephyr/soc/microchip/pic32c/pic32cm_jh/Kconfig.sysbuild"
osource "D:/aguat/Documents/zephyr/zephyr_main/zephyr_main/zephyr_main/zephyr/soc/microchip/miv/Kconfig.sysbuild"
osource "D:/aguat/Documents/zephyr/zephyr_main/zephyr_main/zephyr_main/zephyr/soc/microchip/mec/Kconfig.sysbuild"
osource "D:/aguat/Documents/zephyr/zephyr_main/zephyr_main/zephyr_main/zephyr/soc/mediatek/mt8xxx/Kconfig.sysbuild"
osource "D:/aguat/Documents/zephyr/zephyr_main/zephyr_main/zephyr_main/zephyr/soc/lowrisc/opentitan/Kconfig.sysbuild"
osource "D:/aguat/Documents/zephyr/zephyr_main/zephyr_main/zephyr_main/zephyr/soc/litex/litex_vexriscv/Kconfig.sysbuild"
osource "D:/aguat/Documents/zephyr/zephyr_main/zephyr_main/zephyr_main/zephyr/soc/ite/ec/Kconfig.sysbuild"
osource "D:/aguat/Documents/zephyr/zephyr_main/zephyr_main/zephyr_main/zephyr/soc/intel/raptor_lake/Kconfig.sysbuild"
osource "D:/aguat/Documents/zephyr/zephyr_main/zephyr_main/zephyr_main/zephyr/soc/intel/panther_lake/Kconfig.sysbuild"
osource "D:/aguat/Documents/zephyr/zephyr_main/zephyr_main/zephyr_main/zephyr/soc/intel/lakemont/Kconfig.sysbuild"
osource "D:/aguat/Documents/zephyr/zephyr_main/zephyr_main/zephyr_main/zephyr/soc/intel/intel_socfpga_std/Kconfig.sysbuild"
osource "D:/aguat/Documents/zephyr/zephyr_main/zephyr_main/zephyr_main/zephyr/soc/intel/intel_socfpga/Kconfig.sysbuild"
osource "D:/aguat/Documents/zephyr/zephyr_main/zephyr_main/zephyr_main/zephyr/soc/intel/intel_niosv/Kconfig.sysbuild"
osource "D:/aguat/Documents/zephyr/zephyr_main/zephyr_main/zephyr_main/zephyr/soc/intel/intel_ish/Kconfig.sysbuild"
osource "D:/aguat/Documents/zephyr/zephyr_main/zephyr_main/zephyr_main/zephyr/soc/intel/intel_adsp/Kconfig.sysbuild"
osource "D:/aguat/Documents/zephyr/zephyr_main/zephyr_main/zephyr_main/zephyr/soc/intel/elkhart_lake/Kconfig.sysbuild"
osource "D:/aguat/Documents/zephyr/zephyr_main/zephyr_main/zephyr_main/zephyr/soc/intel/atom/Kconfig.sysbuild"
osource "D:/aguat/Documents/zephyr/zephyr_main/zephyr_main/zephyr_main/zephyr/soc/intel/apollo_lake/Kconfig.sysbuild"
osource "D:/aguat/Documents/zephyr/zephyr_main/zephyr_main/zephyr_main/zephyr/soc/intel/alder_lake/Kconfig.sysbuild"
osource "D:/aguat/Documents/zephyr/zephyr_main/zephyr_main/zephyr_main/zephyr/soc/infineon/cat3/Kconfig.sysbuild"
osource "D:/aguat/Documents/zephyr/zephyr_main/zephyr_main/zephyr_main/zephyr/soc/infineon/cat1c/Kconfig.sysbuild"
osource "D:/aguat/Documents/zephyr/zephyr_main/zephyr_main/zephyr_main/zephyr/soc/infineon/cat1b/Kconfig.sysbuild"
osource "D:/aguat/Documents/zephyr/zephyr_main/zephyr_main/zephyr_main/zephyr/soc/infineon/cat1a/Kconfig.sysbuild"
osource "D:/aguat/Documents/zephyr/zephyr_main/zephyr_main/zephyr_main/zephyr/soc/gd/gd32/Kconfig.sysbuild"
osource "D:/aguat/Documents/zephyr/zephyr_main/zephyr_main/zephyr_main/zephyr/soc/gaisler/leon3/Kconfig.sysbuild"
osource "D:/aguat/Documents/zephyr/zephyr_main/zephyr_main/zephyr_main/zephyr/soc/gaisler/gr716a/Kconfig.sysbuild"
osource "D:/aguat/Documents/zephyr/zephyr_main/zephyr_main/zephyr_main/zephyr/soc/espressif/Kconfig.sysbuild"
osource "D:/aguat/Documents/zephyr/zephyr_main/zephyr_main/zephyr_main/zephyr/soc/ene/kb1200/Kconfig.sysbuild"
osource "D:/aguat/Documents/zephyr/zephyr_main/zephyr_main/zephyr_main/zephyr/soc/ene/kb106x/Kconfig.sysbuild"
osource "D:/aguat/Documents/zephyr/zephyr_main/zephyr_main/zephyr_main/zephyr/soc/efinix/sapphire/Kconfig.sysbuild"
osource "D:/aguat/Documents/zephyr/zephyr_main/zephyr_main/zephyr_main/zephyr/soc/cdns/xtensa_sample_controller/Kconfig.sysbuild"
osource "D:/aguat/Documents/zephyr/zephyr_main/zephyr_main/zephyr_main/zephyr/soc/cdns/sample_controller32/Kconfig.sysbuild"
osource "D:/aguat/Documents/zephyr/zephyr_main/zephyr_main/zephyr_main/zephyr/soc/cdns/dc233c/Kconfig.sysbuild"
osource "D:/aguat/Documents/zephyr/zephyr_main/zephyr_main/zephyr_main/zephyr/soc/brcm/bcmvk/Kconfig.sysbuild"
osource "D:/aguat/Documents/zephyr/zephyr_main/zephyr_main/zephyr_main/zephyr/soc/brcm/bcm2712/Kconfig.sysbuild"
osource "D:/aguat/Documents/zephyr/zephyr_main/zephyr_main/zephyr_main/zephyr/soc/brcm/bcm2711/Kconfig.sysbuild"
osource "D:/aguat/Documents/zephyr/zephyr_main/zephyr_main/zephyr_main/zephyr/soc/bflb/Kconfig.sysbuild"
osource "D:/aguat/Documents/zephyr/zephyr_main/zephyr_main/zephyr_main/zephyr/soc/atmel/sam0/Kconfig.sysbuild"
osource "D:/aguat/Documents/zephyr/zephyr_main/zephyr_main/zephyr_main/zephyr/soc/atmel/sam/Kconfig.sysbuild"
osource "D:/aguat/Documents/zephyr/zephyr_main/zephyr_main/zephyr_main/zephyr/soc/aspeed/Kconfig.sysbuild"
osource "D:/aguat/Documents/zephyr/zephyr_main/zephyr_main/zephyr_main/zephyr/soc/arm/Kconfig.sysbuild"
osource "D:/aguat/Documents/zephyr/zephyr_main/zephyr_main/zephyr_main/zephyr/soc/arm/beetle/Kconfig.sysbuild"
osource "D:/aguat/Documents/zephyr/zephyr_main/zephyr_main/zephyr_main/zephyr/soc/antmicro/myra/Kconfig.sysbuild"
osource "D:/aguat/Documents/zephyr/zephyr_main/zephyr_main/zephyr_main/zephyr/soc/andestech/Kconfig.sysbuild"
osource "D:/aguat/Documents/zephyr/zephyr_main/zephyr_main/zephyr_main/zephyr/soc/amd/acp_6_0/Kconfig.sysbuild"
osource "D:/aguat/Documents/zephyr/zephyr_main/zephyr_main/zephyr_main/zephyr/soc/ambiq/Kconfig.sysbuild"
osource "D:/aguat/Documents/zephyr/zephyr_main/zephyr_main/zephyr_main/zephyr/soc/aesc/Kconfig.sysbuild"
osource "D:/aguat/Documents/zephyr/zephyr_main/zephyr_main/zephyr_main/zephyr/soc/adi/max32/Kconfig.sysbuild"
```
