## blinky/__repo__/build_fdrmmcxc444_threads/Kconfig/soc/Kconfig.soc
```kconfig
# Load SoC Kconfig descriptions.
osource "D:/aguat/Documents/zephyr/zephyr_main/zephyr/soc/xlnx/zynqmp/Kconfig.soc"
osource "D:/aguat/Documents/zephyr/zephyr_main/zephyr/soc/xlnx/zynq7000/Kconfig.soc"
osource "D:/aguat/Documents/zephyr/zephyr_main/zephyr/soc/xlnx/versalnet/Kconfig.soc"
osource "D:/aguat/Documents/zephyr/zephyr_main/zephyr/soc/xlnx/versal2/Kconfig.soc"
osource "D:/aguat/Documents/zephyr/zephyr_main/zephyr/soc/xen/Kconfig.soc"
osource "D:/aguat/Documents/zephyr/zephyr_main/zephyr/soc/wch/ch32v/Kconfig.soc"
osource "D:/aguat/Documents/zephyr/zephyr_main/zephyr/soc/ti/simplelink/Kconfig.soc"
osource "D:/aguat/Documents/zephyr/zephyr_main/zephyr/soc/ti/mspm0/Kconfig.soc"
osource "D:/aguat/Documents/zephyr/zephyr_main/zephyr/soc/ti/lm3s6965/Kconfig.soc"
osource "D:/aguat/Documents/zephyr/zephyr_main/zephyr/soc/ti/k3/Kconfig.soc"
osource "D:/aguat/Documents/zephyr/zephyr_main/zephyr/soc/telink/tlsr/Kconfig.soc"
osource "D:/aguat/Documents/zephyr/zephyr_main/zephyr/soc/starfive/jh71xx/Kconfig.soc"
osource "D:/aguat/Documents/zephyr/zephyr_main/zephyr/soc/st/stm32/Kconfig.soc"
osource "D:/aguat/Documents/zephyr/zephyr_main/zephyr/soc/snps/qemu_arc/Kconfig.soc"
osource "D:/aguat/Documents/zephyr/zephyr_main/zephyr/soc/snps/nsim/arc_v/Kconfig.soc"
osource "D:/aguat/Documents/zephyr/zephyr_main/zephyr/soc/snps/nsim/arc_classic/Kconfig.soc"
osource "D:/aguat/Documents/zephyr/zephyr_main/zephyr/soc/snps/hsdk4xd/Kconfig.soc"
osource "D:/aguat/Documents/zephyr/zephyr_main/zephyr/soc/snps/hsdk/Kconfig.soc"
osource "D:/aguat/Documents/zephyr/zephyr_main/zephyr/soc/snps/emsk/Kconfig.soc"
osource "D:/aguat/Documents/zephyr/zephyr_main/zephyr/soc/snps/emsdp/Kconfig.soc"
osource "D:/aguat/Documents/zephyr/zephyr_main/zephyr/soc/snps/arc_iot/Kconfig.soc"
osource "D:/aguat/Documents/zephyr/zephyr_main/zephyr/soc/silabs/Kconfig.soc"
osource "D:/aguat/Documents/zephyr/zephyr_main/zephyr/soc/sifive/sifive_freedom/Kconfig.soc"
osource "D:/aguat/Documents/zephyr/zephyr_main/zephyr/soc/sensry/Kconfig.soc"
osource "D:/aguat/Documents/zephyr/zephyr_main/zephyr/soc/rockchip/Kconfig.soc"
osource "D:/aguat/Documents/zephyr/zephyr_main/zephyr/soc/renode/riscv_virtual/Kconfig.soc"
osource "D:/aguat/Documents/zephyr/zephyr_main/zephyr/soc/renode/cortex_r8_virtual/Kconfig.soc"
osource "D:/aguat/Documents/zephyr/zephyr_main/zephyr/soc/renesas/smartbond/Kconfig.soc"
osource "D:/aguat/Documents/zephyr/zephyr_main/zephyr/soc/renesas/rz/Kconfig.soc"
osource "D:/aguat/Documents/zephyr/zephyr_main/zephyr/soc/renesas/rx/Kconfig.soc"
osource "D:/aguat/Documents/zephyr/zephyr_main/zephyr/soc/renesas/rcar/Kconfig.soc"
osource "D:/aguat/Documents/zephyr/zephyr_main/zephyr/soc/renesas/ra/Kconfig.soc"
osource "D:/aguat/Documents/zephyr/zephyr_main/zephyr/soc/realtek/ec/Kconfig.soc"
osource "D:/aguat/Documents/zephyr/zephyr_main/zephyr/soc/raspberrypi/rpi_pico/Kconfig.soc"
osource "D:/aguat/Documents/zephyr/zephyr_main/zephyr/soc/quicklogic/eos_s3/Kconfig.soc"
osource "D:/aguat/Documents/zephyr/zephyr_main/zephyr/soc/qemu/virt_riscv/Kconfig.soc"
osource "D:/aguat/Documents/zephyr/zephyr_main/zephyr/soc/qemu/malta/Kconfig.soc"
osource "D:/aguat/Documents/zephyr/zephyr_main/zephyr/soc/openisa/rv32m1/Kconfig.soc"
osource "D:/aguat/Documents/zephyr/zephyr_main/zephyr/soc/openhwgroup/cva6/Kconfig.soc"
osource "D:/aguat/Documents/zephyr/zephyr_main/zephyr/soc/oct/osd32mp15x/Kconfig.soc"
osource "D:/aguat/Documents/zephyr/zephyr_main/zephyr/soc/nxp/s32/Kconfig.soc"
osource "D:/aguat/Documents/zephyr/zephyr_main/zephyr/soc/nxp/rw/Kconfig.soc"
osource "D:/aguat/Documents/zephyr/zephyr_main/zephyr/soc/nxp/mcx/Kconfig.soc"
osource "D:/aguat/Documents/zephyr/zephyr_main/zephyr/soc/nxp/lpc/Kconfig.soc"
osource "D:/aguat/Documents/zephyr/zephyr_main/zephyr/soc/nxp/layerscape/Kconfig.soc"
osource "D:/aguat/Documents/zephyr/zephyr_main/zephyr/soc/nxp/kinetis/Kconfig.soc"
osource "D:/aguat/Documents/zephyr/zephyr_main/zephyr/soc/nxp/imxrt/Kconfig.soc"
osource "D:/aguat/Documents/zephyr/zephyr_main/zephyr/soc/nxp/imx/Kconfig.soc"
osource "D:/aguat/Documents/zephyr/zephyr_main/zephyr/soc/nuvoton/numicro/Kconfig.soc"
osource "D:/aguat/Documents/zephyr/zephyr_main/zephyr/soc/nuvoton/numaker/Kconfig.soc"
osource "D:/aguat/Documents/zephyr/zephyr_main/zephyr/soc/nuvoton/npcx/Kconfig.soc"
osource "D:/aguat/Documents/zephyr/zephyr_main/zephyr/soc/nuvoton/npcm/Kconfig.soc"
osource "D:/aguat/Documents/zephyr/zephyr_main/zephyr/soc/nordic/Kconfig.soc"
osource "D:/aguat/Documents/zephyr/zephyr_main/zephyr/soc/neorv32/Kconfig.soc"
osource "D:/aguat/Documents/zephyr/zephyr_main/zephyr/soc/native/inf_clock/Kconfig.soc"
osource "D:/aguat/Documents/zephyr/zephyr_main/zephyr/soc/microchip/sam/Kconfig.soc"
osource "D:/aguat/Documents/zephyr/zephyr_main/zephyr/soc/microchip/miv/Kconfig.soc"
osource "D:/aguat/Documents/zephyr/zephyr_main/zephyr/soc/microchip/mec/Kconfig.soc"
osource "D:/aguat/Documents/zephyr/zephyr_main/zephyr/soc/mediatek/mt8xxx/Kconfig.soc"
osource "D:/aguat/Documents/zephyr/zephyr_main/zephyr/soc/lowrisc/opentitan/Kconfig.soc"
osource "D:/aguat/Documents/zephyr/zephyr_main/zephyr/soc/litex/litex_vexriscv/Kconfig.soc"
osource "D:/aguat/Documents/zephyr/zephyr_main/zephyr/soc/ite/ec/Kconfig.soc"
osource "D:/aguat/Documents/zephyr/zephyr_main/zephyr/soc/intel/raptor_lake/Kconfig.soc"
osource "D:/aguat/Documents/zephyr/zephyr_main/zephyr/soc/intel/lakemont/Kconfig.soc"
osource "D:/aguat/Documents/zephyr/zephyr_main/zephyr/soc/intel/intel_socfpga_std/Kconfig.soc"
osource "D:/aguat/Documents/zephyr/zephyr_main/zephyr/soc/intel/intel_socfpga/Kconfig.soc"
osource "D:/aguat/Documents/zephyr/zephyr_main/zephyr/soc/intel/intel_niosv/Kconfig.soc"
osource "D:/aguat/Documents/zephyr/zephyr_main/zephyr/soc/intel/intel_ish/Kconfig.soc"
osource "D:/aguat/Documents/zephyr/zephyr_main/zephyr/soc/intel/intel_adsp/Kconfig.soc"
osource "D:/aguat/Documents/zephyr/zephyr_main/zephyr/soc/intel/elkhart_lake/Kconfig.soc"
osource "D:/aguat/Documents/zephyr/zephyr_main/zephyr/soc/intel/atom/Kconfig.soc"
osource "D:/aguat/Documents/zephyr/zephyr_main/zephyr/soc/intel/apollo_lake/Kconfig.soc"
osource "D:/aguat/Documents/zephyr/zephyr_main/zephyr/soc/intel/alder_lake/Kconfig.soc"
osource "D:/aguat/Documents/zephyr/zephyr_main/zephyr/soc/infineon/cat3/Kconfig.soc"
osource "D:/aguat/Documents/zephyr/zephyr_main/zephyr/soc/infineon/cat1c/Kconfig.soc"
osource "D:/aguat/Documents/zephyr/zephyr_main/zephyr/soc/infineon/cat1b/Kconfig.soc"
osource "D:/aguat/Documents/zephyr/zephyr_main/zephyr/soc/infineon/cat1a/Kconfig.soc"
osource "D:/aguat/Documents/zephyr/zephyr_main/zephyr/soc/gd/gd32/Kconfig.soc"
osource "D:/aguat/Documents/zephyr/zephyr_main/zephyr/soc/gaisler/leon3/Kconfig.soc"
osource "D:/aguat/Documents/zephyr/zephyr_main/zephyr/soc/gaisler/gr716a/Kconfig.soc"
osource "D:/aguat/Documents/zephyr/zephyr_main/zephyr/soc/espressif/Kconfig.soc"
osource "D:/aguat/Documents/zephyr/zephyr_main/zephyr/soc/ene/kb1200/Kconfig.soc"
osource "D:/aguat/Documents/zephyr/zephyr_main/zephyr/soc/efinix/sapphire/Kconfig.soc"
osource "D:/aguat/Documents/zephyr/zephyr_main/zephyr/soc/cdns/xtensa_sample_controller/Kconfig.soc"
osource "D:/aguat/Documents/zephyr/zephyr_main/zephyr/soc/cdns/sample_controller32/Kconfig.soc"
osource "D:/aguat/Documents/zephyr/zephyr_main/zephyr/soc/cdns/dc233c/Kconfig.soc"
osource "D:/aguat/Documents/zephyr/zephyr_main/zephyr/soc/brcm/bcmvk/Kconfig.soc"
osource "D:/aguat/Documents/zephyr/zephyr_main/zephyr/soc/brcm/bcm2712/Kconfig.soc"
osource "D:/aguat/Documents/zephyr/zephyr_main/zephyr/soc/brcm/bcm2711/Kconfig.soc"
osource "D:/aguat/Documents/zephyr/zephyr_main/zephyr/soc/bflb/Kconfig.soc"
osource "D:/aguat/Documents/zephyr/zephyr_main/zephyr/soc/atmel/sam0/Kconfig.soc"
osource "D:/aguat/Documents/zephyr/zephyr_main/zephyr/soc/atmel/sam/Kconfig.soc"
osource "D:/aguat/Documents/zephyr/zephyr_main/zephyr/soc/aspeed/Kconfig.soc"
osource "D:/aguat/Documents/zephyr/zephyr_main/zephyr/soc/arm/Kconfig.soc"
osource "D:/aguat/Documents/zephyr/zephyr_main/zephyr/soc/arm/beetle/Kconfig.soc"
osource "D:/aguat/Documents/zephyr/zephyr_main/zephyr/soc/antmicro/myra/Kconfig.soc"
osource "D:/aguat/Documents/zephyr/zephyr_main/zephyr/soc/andestech/Kconfig.soc"
osource "D:/aguat/Documents/zephyr/zephyr_main/zephyr/soc/amd/acp_6_0/Kconfig.soc"
osource "D:/aguat/Documents/zephyr/zephyr_main/zephyr/soc/ambiq/Kconfig.soc"
osource "D:/aguat/Documents/zephyr/zephyr_main/zephyr/soc/aesc/Kconfig.soc"
osource "D:/aguat/Documents/zephyr/zephyr_main/zephyr/soc/adi/max32/Kconfig.soc"
```

## blinky/build/Kconfig/boards/Kconfig.defconfig
```kconfig
# Load Zephyr board defconfig descriptions.
osource "D:/aguat/Documents/zephyr/zephyr_main/zephyr_main/zephyr_main/zephyr/boards/nxp/frdm_mcxc444/Kconfig.defconfig"
```

## blinky2/debug/Kconfig/arch/Kconfig
```kconfig
# Load Zephyr Arch Kconfig descriptions.
osource "D:/aguat/Documents/zephyr/nxp_zephyr/zephyr/arch/rx/Kconfig"
osource "D:/aguat/Documents/zephyr/nxp_zephyr/zephyr/arch/x86/Kconfig"
osource "D:/aguat/Documents/zephyr/nxp_zephyr/zephyr/arch/xtensa/Kconfig"
osource "D:/aguat/Documents/zephyr/nxp_zephyr/zephyr/arch/sparc/Kconfig"
osource "D:/aguat/Documents/zephyr/nxp_zephyr/zephyr/arch/riscv/Kconfig"
osource "D:/aguat/Documents/zephyr/nxp_zephyr/zephyr/arch/posix/Kconfig"
osource "D:/aguat/Documents/zephyr/nxp_zephyr/zephyr/arch/mips/Kconfig"
osource "D:/aguat/Documents/zephyr/nxp_zephyr/zephyr/arch/arm64/Kconfig"
osource "D:/aguat/Documents/zephyr/nxp_zephyr/zephyr/arch/arm/Kconfig"
osource "D:/aguat/Documents/zephyr/nxp_zephyr/zephyr/arch/arc/Kconfig"
```

## blinky2/debug/Kconfig/boards/Kconfig
```kconfig
# Load Zephyr board Kconfig descriptions.
osource "D:/aguat/Documents/zephyr/nxp_zephyr/zephyr/boards/nxp/frdm_mcxc444/Kconfig"
```

## blinky2/debug/Kconfig/boards/Kconfig.defconfig
```kconfig
# Load Zephyr board defconfig descriptions.
osource "D:/aguat/Documents/zephyr/nxp_zephyr/zephyr/boards/nxp/frdm_mcxc444/Kconfig.defconfig"
```

## fdrmmcxc444_threads/build/Kconfig/boards/Kconfig.sysbuild
```kconfig
# Load Sysbuild board Kconfig descriptions.
osource "D:/aguat/Documents/zephyr/zephyr_main/zephyr/boards/nxp/frdm_mcxc444/Kconfig.sysbuild"
```
