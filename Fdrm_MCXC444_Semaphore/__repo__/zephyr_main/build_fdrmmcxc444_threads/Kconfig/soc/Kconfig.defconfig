## Fdrm_MCXC444_Semaphore/__repo__/zephyr_main/build_fdrmmcxc444_threads/Kconfig/soc/Kconfig.defconfig
```kconfig
# Load Zephyr SoC defconfig descriptions.
osource "D:/aguat/Documents/zephyr/zephyr_main/zephyr/soc/xlnx/zynqmp/Kconfig.defconfig"
osource "D:/aguat/Documents/zephyr/zephyr_main/zephyr/soc/xlnx/zynq7000/Kconfig.defconfig"
osource "D:/aguat/Documents/zephyr/zephyr_main/zephyr/soc/xlnx/versalnet/Kconfig.defconfig"
osource "D:/aguat/Documents/zephyr/zephyr_main/zephyr/soc/xlnx/versal2/Kconfig.defconfig"
osource "D:/aguat/Documents/zephyr/zephyr_main/zephyr/soc/xen/Kconfig.defconfig"
osource "D:/aguat/Documents/zephyr/zephyr_main/zephyr/soc/wch/ch32v/Kconfig.defconfig"
osource "D:/aguat/Documents/zephyr/zephyr_main/zephyr/soc/ti/simplelink/Kconfig.defconfig"
osource "D:/aguat/Documents/zephyr/zephyr_main/zephyr/soc/ti/mspm0/Kconfig.defconfig"
osource "D:/aguat/Documents/zephyr/zephyr_main/zephyr/soc/ti/lm3s6965/Kconfig.defconfig"
osource "D:/aguat/Documents/zephyr/zephyr_main/zephyr/soc/ti/k3/Kconfig.defconfig"
osource "D:/aguat/Documents/zephyr/zephyr_main/zephyr/soc/telink/tlsr/Kconfig.defconfig"
osource "D:/aguat/Documents/zephyr/zephyr_main/zephyr/soc/starfive/jh71xx/Kconfig.defconfig"
osource "D:/aguat/Documents/zephyr/zephyr_main/zephyr/soc/st/stm32/Kconfig.defconfig"
osource "D:/aguat/Documents/zephyr/zephyr_main/zephyr/soc/snps/qemu_arc/Kconfig.defconfig"
osource "D:/aguat/Documents/zephyr/zephyr_main/zephyr/soc/snps/nsim/arc_v/Kconfig.defconfig"
osource "D:/aguat/Documents/zephyr/zephyr_main/zephyr/soc/snps/nsim/arc_classic/Kconfig.defconfig"
osource "D:/aguat/Documents/zephyr/zephyr_main/zephyr/soc/snps/hsdk4xd/Kconfig.defconfig"
osource "D:/aguat/Documents/zephyr/zephyr_main/zephyr/soc/snps/hsdk/Kconfig.defconfig"
osource "D:/aguat/Documents/zephyr/zephyr_main/zephyr/soc/snps/emsk/Kconfig.defconfig"
osource "D:/aguat/Documents/zephyr/zephyr_main/zephyr/soc/snps/emsdp/Kconfig.defconfig"
osource "D:/aguat/Documents/zephyr/zephyr_main/zephyr/soc/snps/arc_iot/Kconfig.defconfig"
osource "D:/aguat/Documents/zephyr/zephyr_main/zephyr/soc/silabs/Kconfig.defconfig"
osource "D:/aguat/Documents/zephyr/zephyr_main/zephyr/soc/sifive/sifive_freedom/Kconfig.defconfig"
osource "D:/aguat/Documents/zephyr/zephyr_main/zephyr/soc/sensry/Kconfig.defconfig"
osource "D:/aguat/Documents/zephyr/zephyr_main/zephyr/soc/rockchip/Kconfig.defconfig"
osource "D:/aguat/Documents/zephyr/zephyr_main/zephyr/soc/renode/riscv_virtual/Kconfig.defconfig"
osource "D:/aguat/Documents/zephyr/zephyr_main/zephyr/soc/renode/cortex_r8_virtual/Kconfig.defconfig"
osource "D:/aguat/Documents/zephyr/zephyr_main/zephyr/soc/renesas/smartbond/Kconfig.defconfig"
osource "D:/aguat/Documents/zephyr/zephyr_main/zephyr/soc/renesas/rz/Kconfig.defconfig"
osource "D:/aguat/Documents/zephyr/zephyr_main/zephyr/soc/renesas/rx/Kconfig.defconfig"
osource "D:/aguat/Documents/zephyr/zephyr_main/zephyr/soc/renesas/rcar/Kconfig.defconfig"
osource "D:/aguat/Documents/zephyr/zephyr_main/zephyr/soc/renesas/ra/Kconfig.defconfig"
osource "D:/aguat/Documents/zephyr/zephyr_main/zephyr/soc/realtek/ec/Kconfig.defconfig"
osource "D:/aguat/Documents/zephyr/zephyr_main/zephyr/soc/raspberrypi/rpi_pico/Kconfig.defconfig"
osource "D:/aguat/Documents/zephyr/zephyr_main/zephyr/soc/quicklogic/eos_s3/Kconfig.defconfig"
osource "D:/aguat/Documents/zephyr/zephyr_main/zephyr/soc/qemu/virt_riscv/Kconfig.defconfig"
osource "D:/aguat/Documents/zephyr/zephyr_main/zephyr/soc/qemu/malta/Kconfig.defconfig"
osource "D:/aguat/Documents/zephyr/zephyr_main/zephyr/soc/openisa/rv32m1/Kconfig.defconfig"
osource "D:/aguat/Documents/zephyr/zephyr_main/zephyr/soc/openhwgroup/cva6/Kconfig.defconfig"
osource "D:/aguat/Documents/zephyr/zephyr_main/zephyr/soc/oct/osd32mp15x/Kconfig.defconfig"
osource "D:/aguat/Documents/zephyr/zephyr_main/zephyr/soc/nxp/s32/Kconfig.defconfig"
osource "D:/aguat/Documents/zephyr/zephyr_main/zephyr/soc/nxp/rw/Kconfig.defconfig"
osource "D:/aguat/Documents/zephyr/zephyr_main/zephyr/soc/nxp/mcx/Kconfig.defconfig"
osource "D:/aguat/Documents/zephyr/zephyr_main/zephyr/soc/nxp/lpc/Kconfig.defconfig"
osource "D:/aguat/Documents/zephyr/zephyr_main/zephyr/soc/nxp/layerscape/Kconfig.defconfig"
osource "D:/aguat/Documents/zephyr/zephyr_main/zephyr/soc/nxp/kinetis/Kconfig.defconfig"
osource "D:/aguat/Documents/zephyr/zephyr_main/zephyr/soc/nxp/imxrt/Kconfig.defconfig"
osource "D:/aguat/Documents/zephyr/zephyr_main/zephyr/soc/nxp/imx/Kconfig.defconfig"
osource "D:/aguat/Documents/zephyr/zephyr_main/zephyr/soc/nuvoton/numicro/Kconfig.defconfig"
osource "D:/aguat/Documents/zephyr/zephyr_main/zephyr/soc/nuvoton/numaker/Kconfig.defconfig"
osource "D:/aguat/Documents/zephyr/zephyr_main/zephyr/soc/nuvoton/npcx/Kconfig.defconfig"
osource "D:/aguat/Documents/zephyr/zephyr_main/zephyr/soc/nuvoton/npcm/Kconfig.defconfig"
osource "D:/aguat/Documents/zephyr/zephyr_main/zephyr/soc/nordic/Kconfig.defconfig"
osource "D:/aguat/Documents/zephyr/zephyr_main/zephyr/soc/neorv32/Kconfig.defconfig"
osource "D:/aguat/Documents/zephyr/zephyr_main/zephyr/soc/native/inf_clock/Kconfig.defconfig"
osource "D:/aguat/Documents/zephyr/zephyr_main/zephyr/soc/microchip/sam/Kconfig.defconfig"
osource "D:/aguat/Documents/zephyr/zephyr_main/zephyr/soc/microchip/miv/Kconfig.defconfig"
osource "D:/aguat/Documents/zephyr/zephyr_main/zephyr/soc/microchip/mec/Kconfig.defconfig"
osource "D:/aguat/Documents/zephyr/zephyr_main/zephyr/soc/mediatek/mt8xxx/Kconfig.defconfig"
osource "D:/aguat/Documents/zephyr/zephyr_main/zephyr/soc/lowrisc/opentitan/Kconfig.defconfig"
osource "D:/aguat/Documents/zephyr/zephyr_main/zephyr/soc/litex/litex_vexriscv/Kconfig.defconfig"
osource "D:/aguat/Documents/zephyr/zephyr_main/zephyr/soc/ite/ec/Kconfig.defconfig"
osource "D:/aguat/Documents/zephyr/zephyr_main/zephyr/soc/intel/raptor_lake/Kconfig.defconfig"
osource "D:/aguat/Documents/zephyr/zephyr_main/zephyr/soc/intel/lakemont/Kconfig.defconfig"
osource "D:/aguat/Documents/zephyr/zephyr_main/zephyr/soc/intel/intel_socfpga_std/Kconfig.defconfig"
osource "D:/aguat/Documents/zephyr/zephyr_main/zephyr/soc/intel/intel_socfpga/Kconfig.defconfig"
osource "D:/aguat/Documents/zephyr/zephyr_main/zephyr/soc/intel/intel_niosv/Kconfig.defconfig"
osource "D:/aguat/Documents/zephyr/zephyr_main/zephyr/soc/intel/intel_ish/Kconfig.defconfig"
osource "D:/aguat/Documents/zephyr/zephyr_main/zephyr/soc/intel/intel_adsp/Kconfig.defconfig"
osource "D:/aguat/Documents/zephyr/zephyr_main/zephyr/soc/intel/elkhart_lake/Kconfig.defconfig"
osource "D:/aguat/Documents/zephyr/zephyr_main/zephyr/soc/intel/atom/Kconfig.defconfig"
osource "D:/aguat/Documents/zephyr/zephyr_main/zephyr/soc/intel/apollo_lake/Kconfig.defconfig"
osource "D:/aguat/Documents/zephyr/zephyr_main/zephyr/soc/intel/alder_lake/Kconfig.defconfig"
osource "D:/aguat/Documents/zephyr/zephyr_main/zephyr/soc/infineon/cat3/Kconfig.defconfig"
osource "D:/aguat/Documents/zephyr/zephyr_main/zephyr/soc/infineon/cat1c/Kconfig.defconfig"
osource "D:/aguat/Documents/zephyr/zephyr_main/zephyr/soc/infineon/cat1b/Kconfig.defconfig"
osource "D:/aguat/Documents/zephyr/zephyr_main/zephyr/soc/infineon/cat1a/Kconfig.defconfig"
osource "D:/aguat/Documents/zephyr/zephyr_main/zephyr/soc/gd/gd32/Kconfig.defconfig"
osource "D:/aguat/Documents/zephyr/zephyr_main/zephyr/soc/gaisler/leon3/Kconfig.defconfig"
osource "D:/aguat/Documents/zephyr/zephyr_main/zephyr/soc/gaisler/gr716a/Kconfig.defconfig"
osource "D:/aguat/Documents/zephyr/zephyr_main/zephyr/soc/espressif/Kconfig.defconfig"
osource "D:/aguat/Documents/zephyr/zephyr_main/zephyr/soc/ene/kb1200/Kconfig.defconfig"
osource "D:/aguat/Documents/zephyr/zephyr_main/zephyr/soc/efinix/sapphire/Kconfig.defconfig"
osource "D:/aguat/Documents/zephyr/zephyr_main/zephyr/soc/cdns/xtensa_sample_controller/Kconfig.defconfig"
osource "D:/aguat/Documents/zephyr/zephyr_main/zephyr/soc/cdns/sample_controller32/Kconfig.defconfig"
osource "D:/aguat/Documents/zephyr/zephyr_main/zephyr/soc/cdns/dc233c/Kconfig.defconfig"
osource "D:/aguat/Documents/zephyr/zephyr_main/zephyr/soc/brcm/bcmvk/Kconfig.defconfig"
osource "D:/aguat/Documents/zephyr/zephyr_main/zephyr/soc/brcm/bcm2712/Kconfig.defconfig"
osource "D:/aguat/Documents/zephyr/zephyr_main/zephyr/soc/brcm/bcm2711/Kconfig.defconfig"
osource "D:/aguat/Documents/zephyr/zephyr_main/zephyr/soc/bflb/Kconfig.defconfig"
osource "D:/aguat/Documents/zephyr/zephyr_main/zephyr/soc/atmel/sam0/Kconfig.defconfig"
osource "D:/aguat/Documents/zephyr/zephyr_main/zephyr/soc/atmel/sam/Kconfig.defconfig"
osource "D:/aguat/Documents/zephyr/zephyr_main/zephyr/soc/aspeed/Kconfig.defconfig"
osource "D:/aguat/Documents/zephyr/zephyr_main/zephyr/soc/arm/Kconfig.defconfig"
osource "D:/aguat/Documents/zephyr/zephyr_main/zephyr/soc/arm/beetle/Kconfig.defconfig"
osource "D:/aguat/Documents/zephyr/zephyr_main/zephyr/soc/antmicro/myra/Kconfig.defconfig"
osource "D:/aguat/Documents/zephyr/zephyr_main/zephyr/soc/andestech/Kconfig.defconfig"
osource "D:/aguat/Documents/zephyr/zephyr_main/zephyr/soc/amd/acp_6_0/Kconfig.defconfig"
osource "D:/aguat/Documents/zephyr/zephyr_main/zephyr/soc/ambiq/Kconfig.defconfig"
osource "D:/aguat/Documents/zephyr/zephyr_main/zephyr/soc/aesc/Kconfig.defconfig"
osource "D:/aguat/Documents/zephyr/zephyr_main/zephyr/soc/adi/max32/Kconfig.defconfig"
```

## Fdrm_MCXC444_Semaphore/debug/Kconfig/Kconfig.modules
```kconfig
menu "zsdk (D:/aguat/Documents/zephyr/nxp_zephyr/zsdk)"
osource "D:/aguat/Documents/zephyr/nxp_zephyr/zsdk/Kconfig.nxp"
config ZEPHYR_ZSDK_MODULE
	bool
	default y
endmenu
menu "hal_nxp (D:/aguat/Documents/zephyr/nxp_zephyr/modules/hal/nxp)"
osource "$(ZEPHYR_HAL_NXP_KCONFIG)"
config ZEPHYR_HAL_NXP_MODULE
	bool
	default y
	select TAINT_BLOBS

config ZEPHYR_HAL_NXP_MODULE_BLOBS
	bool
	default y
endmenu
menu "els_pkc (D:/aguat/Documents/zephyr/nxp_zephyr/modules/crypto/els_pkc)"
osource "D:/aguat/Documents/zephyr/nxp_zephyr/modules/crypto/els_pkc/zephyr/Kconfig"
config ZEPHYR_ELS_PKC_MODULE
	bool
	default y
endmenu
menu "psa_crypto_driver (D:/aguat/Documents/zephyr/nxp_zephyr/modules/crypto/psa_crypto_driver)"
osource "D:/aguat/Documents/zephyr/nxp_zephyr/modules/crypto/psa_crypto_driver/zephyr/Kconfig"
config ZEPHYR_PSA_CRYPTO_DRIVER_MODULE
	bool
	default y
endmenu
menu "mbedtls (D:/aguat/Documents/zephyr/nxp_zephyr/modules/crypto/mbedtls)"
osource "$(ZEPHYR_MBEDTLS_KCONFIG)"
config ZEPHYR_MBEDTLS_MODULE
	bool
	default y
endmenu
menu "trusted-firmware-m (D:/aguat/Documents/zephyr/nxp_zephyr/modules/tee/tf-m/trusted-firmware-m)"
osource "$(ZEPHYR_TRUSTED_FIRMWARE_M_KCONFIG)"
config ZEPHYR_TRUSTED_FIRMWARE_M_MODULE
	bool
	default y
endmenu
config ZEPHYR_PSA_ARCH_TESTS_MODULE
	bool
	default y
config ZEPHYR_TF_M_TESTS_MODULE
	bool
	default y
menu "hostap (D:/aguat/Documents/zephyr/nxp_zephyr/modules/lib/hostap)"
osource "$(ZEPHYR_HOSTAP_KCONFIG)"
config ZEPHYR_HOSTAP_MODULE
	bool
	default y
endmenu
menu "nxp_iot_agent (D:/aguat/Documents/zephyr/nxp_zephyr/modules/lib/nxp_iot_agent)"
osource "D:/aguat/Documents/zephyr/nxp_zephyr/modules/lib/nxp_iot_agent/zephyr/Kconfig"
config ZEPHYR_NXP_IOT_AGENT_MODULE
	bool
	default y
endmenu
menu "canopennode (D:/aguat/Documents/zephyr/nxp_zephyr/modules/lib/canopennode)"
osource "$(ZEPHYR_CANOPENNODE_KCONFIG)"
config ZEPHYR_CANOPENNODE_MODULE
	bool
	default y
endmenu
menu "chre (D:/aguat/Documents/zephyr/nxp_zephyr/modules/lib/chre)"
osource "D:/aguat/Documents/zephyr/nxp_zephyr/modules/lib/chre/platform/zephyr/Kconfig"
config ZEPHYR_CHRE_MODULE
	bool
	default y
endmenu
menu "lz4 (D:/aguat/Documents/zephyr/nxp_zephyr/modules/lib/lz4)"
osource "$(ZEPHYR_LZ4_KCONFIG)"
config ZEPHYR_LZ4_MODULE
	bool
	default y
endmenu
menu "zscilib (D:/aguat/Documents/zephyr/nxp_zephyr/modules/lib/zscilib)"
osource "D:/aguat/Documents/zephyr/nxp_zephyr/modules/lib/zscilib/Kconfig.zscilib"
config ZEPHYR_ZSCILIB_MODULE
	bool
	default y
endmenu
menu "cmsis (D:/aguat/Documents/zephyr/nxp_zephyr/modules/hal/cmsis)"
osource "$(ZEPHYR_CMSIS_KCONFIG)"
config ZEPHYR_CMSIS_MODULE
	bool
	default y
endmenu
menu "cmsis-dsp (D:/aguat/Documents/zephyr/nxp_zephyr/modules/lib/cmsis-dsp)"
osource "$(ZEPHYR_CMSIS_DSP_KCONFIG)"
config ZEPHYR_CMSIS_DSP_MODULE
	bool
	default y
endmenu
menu "cmsis-nn (D:/aguat/Documents/zephyr/nxp_zephyr/modules/lib/cmsis-nn)"
osource "$(ZEPHYR_CMSIS_NN_KCONFIG)"
config ZEPHYR_CMSIS_NN_MODULE
	bool
	default y
endmenu
menu "cmsis_6 (D:/aguat/Documents/zephyr/nxp_zephyr/modules/hal/cmsis_6)"
osource "$(ZEPHYR_CMSIS_6_KCONFIG)"
config ZEPHYR_CMSIS_6_MODULE
	bool
	default y
endmenu
menu "fatfs (D:/aguat/Documents/zephyr/nxp_zephyr/modules/fs/fatfs)"
osource "$(ZEPHYR_FATFS_KCONFIG)"
config ZEPHYR_FATFS_MODULE
	bool
	default y
endmenu
menu "hal_st (D:/aguat/Documents/zephyr/nxp_zephyr/modules/hal/st)"
osource "$(ZEPHYR_HAL_ST_KCONFIG)"
config ZEPHYR_HAL_ST_MODULE
	bool
	default y
endmenu
config ZEPHYR_XTENSA_MODULE
	bool
	default y
menu "liblc3 (D:/aguat/Documents/zephyr/nxp_zephyr/modules/lib/liblc3)"
osource "$(ZEPHYR_LIBLC3_KCONFIG)"
config ZEPHYR_LIBLC3_MODULE
	bool
	default y
endmenu
config ZEPHYR_LIBMETAL_MODULE
	bool
	default y
menu "littlefs (D:/aguat/Documents/zephyr/nxp_zephyr/modules/fs/littlefs)"
osource "$(ZEPHYR_LITTLEFS_KCONFIG)"
config ZEPHYR_LITTLEFS_MODULE
	bool
	default y
endmenu
menu "loramac-node (D:/aguat/Documents/zephyr/nxp_zephyr/modules/lib/loramac-node)"
osource "$(ZEPHYR_LORAMAC_NODE_KCONFIG)"
config ZEPHYR_LORAMAC_NODE_MODULE
	bool
	default y
endmenu
menu "lvgl (D:/aguat/Documents/zephyr/nxp_zephyr/modules/lib/gui/lvgl)"
osource "D:/aguat/Documents/zephyr/nxp_zephyr/modules/lib/gui/lvgl/zephyr/Kconfig"
config ZEPHYR_LVGL_MODULE
	bool
	default y
endmenu
config ZEPHYR_MCUBOOT_MODULE
	bool
	default y
config ZEPHYR_MIPI_SYS_T_MODULE
	bool
	default y
config ZEPHYR_OPEN_AMP_MODULE
	bool
	default y
menu "openthread (D:/aguat/Documents/zephyr/nxp_zephyr/modules/lib/openthread)"
osource "$(ZEPHYR_OPENTHREAD_KCONFIG)"
config ZEPHYR_OPENTHREAD_MODULE
	bool
	default y
endmenu
menu "picolibc (D:/aguat/Documents/zephyr/nxp_zephyr/modules/lib/picolibc)"
osource "D:/aguat/Documents/zephyr/nxp_zephyr/modules/lib/picolibc/zephyr/Kconfig"
config ZEPHYR_PICOLIBC_MODULE
	bool
	default y
endmenu
menu "segger (D:/aguat/Documents/zephyr/nxp_zephyr/modules/debug/segger)"
osource "$(ZEPHYR_SEGGER_KCONFIG)"
config ZEPHYR_SEGGER_MODULE
	bool
	default y
endmenu
config ZEPHYR_TINYCRYPT_MODULE
	bool
	default y
menu "uoscore-uedhoc (D:/aguat/Documents/zephyr/nxp_zephyr/modules/lib/uoscore-uedhoc)"
osource "$(ZEPHYR_UOSCORE_UEDHOC_KCONFIG)"
config ZEPHYR_UOSCORE_UEDHOC_MODULE
	bool
	default y
endmenu
menu "zcbor (D:/aguat/Documents/zephyr/nxp_zephyr/modules/lib/zcbor)"
osource "$(ZEPHYR_ZCBOR_KCONFIG)"
config ZEPHYR_ZCBOR_MODULE
	bool
	default y
endmenu
```
