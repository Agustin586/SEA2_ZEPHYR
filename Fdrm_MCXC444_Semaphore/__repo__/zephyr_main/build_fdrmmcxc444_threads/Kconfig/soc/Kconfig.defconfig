## Frdm_MCXC444_Threads/__repo__/build_fdrmmcxc444_threads/Kconfig/soc/Kconfig
```kconfig
# Load Zephyr SoC Kconfig descriptions.
osource "D:/aguat/Documents/zephyr/zephyr_main/zephyr/soc/xlnx/zynqmp/Kconfig"
osource "D:/aguat/Documents/zephyr/zephyr_main/zephyr/soc/xlnx/zynq7000/Kconfig"
osource "D:/aguat/Documents/zephyr/zephyr_main/zephyr/soc/xlnx/versalnet/Kconfig"
osource "D:/aguat/Documents/zephyr/zephyr_main/zephyr/soc/xlnx/versal2/Kconfig"
osource "D:/aguat/Documents/zephyr/zephyr_main/zephyr/soc/xen/Kconfig"
osource "D:/aguat/Documents/zephyr/zephyr_main/zephyr/soc/wch/ch32v/Kconfig"
osource "D:/aguat/Documents/zephyr/zephyr_main/zephyr/soc/ti/simplelink/Kconfig"
osource "D:/aguat/Documents/zephyr/zephyr_main/zephyr/soc/ti/mspm0/Kconfig"
osource "D:/aguat/Documents/zephyr/zephyr_main/zephyr/soc/ti/lm3s6965/Kconfig"
osource "D:/aguat/Documents/zephyr/zephyr_main/zephyr/soc/ti/k3/Kconfig"
osource "D:/aguat/Documents/zephyr/zephyr_main/zephyr/soc/telink/tlsr/Kconfig"
osource "D:/aguat/Documents/zephyr/zephyr_main/zephyr/soc/starfive/jh71xx/Kconfig"
osource "D:/aguat/Documents/zephyr/zephyr_main/zephyr/soc/st/stm32/Kconfig"
osource "D:/aguat/Documents/zephyr/zephyr_main/zephyr/soc/snps/qemu_arc/Kconfig"
osource "D:/aguat/Documents/zephyr/zephyr_main/zephyr/soc/snps/nsim/arc_v/Kconfig"
osource "D:/aguat/Documents/zephyr/zephyr_main/zephyr/soc/snps/nsim/arc_classic/Kconfig"
osource "D:/aguat/Documents/zephyr/zephyr_main/zephyr/soc/snps/hsdk4xd/Kconfig"
osource "D:/aguat/Documents/zephyr/zephyr_main/zephyr/soc/snps/hsdk/Kconfig"
osource "D:/aguat/Documents/zephyr/zephyr_main/zephyr/soc/snps/emsk/Kconfig"
osource "D:/aguat/Documents/zephyr/zephyr_main/zephyr/soc/snps/emsdp/Kconfig"
osource "D:/aguat/Documents/zephyr/zephyr_main/zephyr/soc/snps/arc_iot/Kconfig"
osource "D:/aguat/Documents/zephyr/zephyr_main/zephyr/soc/silabs/Kconfig"
osource "D:/aguat/Documents/zephyr/zephyr_main/zephyr/soc/sifive/sifive_freedom/Kconfig"
osource "D:/aguat/Documents/zephyr/zephyr_main/zephyr/soc/sensry/Kconfig"
osource "D:/aguat/Documents/zephyr/zephyr_main/zephyr/soc/rockchip/Kconfig"
osource "D:/aguat/Documents/zephyr/zephyr_main/zephyr/soc/renode/riscv_virtual/Kconfig"
osource "D:/aguat/Documents/zephyr/zephyr_main/zephyr/soc/renode/cortex_r8_virtual/Kconfig"
osource "D:/aguat/Documents/zephyr/zephyr_main/zephyr/soc/renesas/smartbond/Kconfig"
osource "D:/aguat/Documents/zephyr/zephyr_main/zephyr/soc/renesas/rz/Kconfig"
osource "D:/aguat/Documents/zephyr/zephyr_main/zephyr/soc/renesas/rx/Kconfig"
osource "D:/aguat/Documents/zephyr/zephyr_main/zephyr/soc/renesas/rcar/Kconfig"
osource "D:/aguat/Documents/zephyr/zephyr_main/zephyr/soc/renesas/ra/Kconfig"
osource "D:/aguat/Documents/zephyr/zephyr_main/zephyr/soc/realtek/ec/Kconfig"
osource "D:/aguat/Documents/zephyr/zephyr_main/zephyr/soc/raspberrypi/rpi_pico/Kconfig"
osource "D:/aguat/Documents/zephyr/zephyr_main/zephyr/soc/quicklogic/eos_s3/Kconfig"
osource "D:/aguat/Documents/zephyr/zephyr_main/zephyr/soc/qemu/virt_riscv/Kconfig"
osource "D:/aguat/Documents/zephyr/zephyr_main/zephyr/soc/qemu/malta/Kconfig"
osource "D:/aguat/Documents/zephyr/zephyr_main/zephyr/soc/openisa/rv32m1/Kconfig"
osource "D:/aguat/Documents/zephyr/zephyr_main/zephyr/soc/openhwgroup/cva6/Kconfig"
osource "D:/aguat/Documents/zephyr/zephyr_main/zephyr/soc/oct/osd32mp15x/Kconfig"
osource "D:/aguat/Documents/zephyr/zephyr_main/zephyr/soc/nxp/s32/Kconfig"
osource "D:/aguat/Documents/zephyr/zephyr_main/zephyr/soc/nxp/rw/Kconfig"
osource "D:/aguat/Documents/zephyr/zephyr_main/zephyr/soc/nxp/mcx/Kconfig"
osource "D:/aguat/Documents/zephyr/zephyr_main/zephyr/soc/nxp/lpc/Kconfig"
osource "D:/aguat/Documents/zephyr/zephyr_main/zephyr/soc/nxp/layerscape/Kconfig"
osource "D:/aguat/Documents/zephyr/zephyr_main/zephyr/soc/nxp/kinetis/Kconfig"
osource "D:/aguat/Documents/zephyr/zephyr_main/zephyr/soc/nxp/imxrt/Kconfig"
osource "D:/aguat/Documents/zephyr/zephyr_main/zephyr/soc/nxp/imx/Kconfig"
osource "D:/aguat/Documents/zephyr/zephyr_main/zephyr/soc/nuvoton/numicro/Kconfig"
osource "D:/aguat/Documents/zephyr/zephyr_main/zephyr/soc/nuvoton/numaker/Kconfig"
osource "D:/aguat/Documents/zephyr/zephyr_main/zephyr/soc/nuvoton/npcx/Kconfig"
osource "D:/aguat/Documents/zephyr/zephyr_main/zephyr/soc/nuvoton/npcm/Kconfig"
osource "D:/aguat/Documents/zephyr/zephyr_main/zephyr/soc/nordic/Kconfig"
osource "D:/aguat/Documents/zephyr/zephyr_main/zephyr/soc/neorv32/Kconfig"
osource "D:/aguat/Documents/zephyr/zephyr_main/zephyr/soc/native/inf_clock/Kconfig"
osource "D:/aguat/Documents/zephyr/zephyr_main/zephyr/soc/microchip/sam/Kconfig"
osource "D:/aguat/Documents/zephyr/zephyr_main/zephyr/soc/microchip/miv/Kconfig"
osource "D:/aguat/Documents/zephyr/zephyr_main/zephyr/soc/microchip/mec/Kconfig"
osource "D:/aguat/Documents/zephyr/zephyr_main/zephyr/soc/mediatek/mt8xxx/Kconfig"
osource "D:/aguat/Documents/zephyr/zephyr_main/zephyr/soc/lowrisc/opentitan/Kconfig"
osource "D:/aguat/Documents/zephyr/zephyr_main/zephyr/soc/litex/litex_vexriscv/Kconfig"
osource "D:/aguat/Documents/zephyr/zephyr_main/zephyr/soc/ite/ec/Kconfig"
osource "D:/aguat/Documents/zephyr/zephyr_main/zephyr/soc/intel/raptor_lake/Kconfig"
osource "D:/aguat/Documents/zephyr/zephyr_main/zephyr/soc/intel/lakemont/Kconfig"
osource "D:/aguat/Documents/zephyr/zephyr_main/zephyr/soc/intel/intel_socfpga_std/Kconfig"
osource "D:/aguat/Documents/zephyr/zephyr_main/zephyr/soc/intel/intel_socfpga/Kconfig"
osource "D:/aguat/Documents/zephyr/zephyr_main/zephyr/soc/intel/intel_niosv/Kconfig"
osource "D:/aguat/Documents/zephyr/zephyr_main/zephyr/soc/intel/intel_ish/Kconfig"
osource "D:/aguat/Documents/zephyr/zephyr_main/zephyr/soc/intel/intel_adsp/Kconfig"
osource "D:/aguat/Documents/zephyr/zephyr_main/zephyr/soc/intel/elkhart_lake/Kconfig"
osource "D:/aguat/Documents/zephyr/zephyr_main/zephyr/soc/intel/atom/Kconfig"
osource "D:/aguat/Documents/zephyr/zephyr_main/zephyr/soc/intel/apollo_lake/Kconfig"
osource "D:/aguat/Documents/zephyr/zephyr_main/zephyr/soc/intel/alder_lake/Kconfig"
osource "D:/aguat/Documents/zephyr/zephyr_main/zephyr/soc/infineon/cat3/Kconfig"
osource "D:/aguat/Documents/zephyr/zephyr_main/zephyr/soc/infineon/cat1c/Kconfig"
osource "D:/aguat/Documents/zephyr/zephyr_main/zephyr/soc/infineon/cat1b/Kconfig"
osource "D:/aguat/Documents/zephyr/zephyr_main/zephyr/soc/infineon/cat1a/Kconfig"
osource "D:/aguat/Documents/zephyr/zephyr_main/zephyr/soc/gd/gd32/Kconfig"
osource "D:/aguat/Documents/zephyr/zephyr_main/zephyr/soc/gaisler/leon3/Kconfig"
osource "D:/aguat/Documents/zephyr/zephyr_main/zephyr/soc/gaisler/gr716a/Kconfig"
osource "D:/aguat/Documents/zephyr/zephyr_main/zephyr/soc/espressif/Kconfig"
osource "D:/aguat/Documents/zephyr/zephyr_main/zephyr/soc/ene/kb1200/Kconfig"
osource "D:/aguat/Documents/zephyr/zephyr_main/zephyr/soc/efinix/sapphire/Kconfig"
osource "D:/aguat/Documents/zephyr/zephyr_main/zephyr/soc/cdns/xtensa_sample_controller/Kconfig"
osource "D:/aguat/Documents/zephyr/zephyr_main/zephyr/soc/cdns/sample_controller32/Kconfig"
osource "D:/aguat/Documents/zephyr/zephyr_main/zephyr/soc/cdns/dc233c/Kconfig"
osource "D:/aguat/Documents/zephyr/zephyr_main/zephyr/soc/brcm/bcmvk/Kconfig"
osource "D:/aguat/Documents/zephyr/zephyr_main/zephyr/soc/brcm/bcm2712/Kconfig"
osource "D:/aguat/Documents/zephyr/zephyr_main/zephyr/soc/brcm/bcm2711/Kconfig"
osource "D:/aguat/Documents/zephyr/zephyr_main/zephyr/soc/bflb/Kconfig"
osource "D:/aguat/Documents/zephyr/zephyr_main/zephyr/soc/atmel/sam0/Kconfig"
osource "D:/aguat/Documents/zephyr/zephyr_main/zephyr/soc/atmel/sam/Kconfig"
osource "D:/aguat/Documents/zephyr/zephyr_main/zephyr/soc/aspeed/Kconfig"
osource "D:/aguat/Documents/zephyr/zephyr_main/zephyr/soc/arm/Kconfig"
osource "D:/aguat/Documents/zephyr/zephyr_main/zephyr/soc/arm/beetle/Kconfig"
osource "D:/aguat/Documents/zephyr/zephyr_main/zephyr/soc/antmicro/myra/Kconfig"
osource "D:/aguat/Documents/zephyr/zephyr_main/zephyr/soc/andestech/Kconfig"
osource "D:/aguat/Documents/zephyr/zephyr_main/zephyr/soc/amd/acp_6_0/Kconfig"
osource "D:/aguat/Documents/zephyr/zephyr_main/zephyr/soc/ambiq/Kconfig"
osource "D:/aguat/Documents/zephyr/zephyr_main/zephyr/soc/aesc/Kconfig"
osource "D:/aguat/Documents/zephyr/zephyr_main/zephyr/soc/adi/max32/Kconfig"
```

## Frdm_MCXC444_Threads/build/Kconfig/boards/Kconfig.frdm_mcxc444
```kconfig
# Load board Kconfig descriptions.
osource "D:/aguat/Documents/zephyr/zephyr_main/zephyr/boards/nxp/frdm_mcxc444/Kconfig.frdm_mcxc444"
```
