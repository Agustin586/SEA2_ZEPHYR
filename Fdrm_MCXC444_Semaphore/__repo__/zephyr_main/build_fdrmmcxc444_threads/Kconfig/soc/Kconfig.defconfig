## blinky/__repo__/build_fdrmmcxc444_threads/Kconfig/Kconfig.modules
```kconfig
menu "acpica (D:/aguat/Documents/zephyr/zephyr_main/modules/lib/acpica)"
osource "$(ZEPHYR_ACPICA_KCONFIG)"
config ZEPHYR_ACPICA_MODULE
	bool
	default y
endmenu
menu "cmsis (D:/aguat/Documents/zephyr/zephyr_main/modules/hal/cmsis)"
osource "$(ZEPHYR_CMSIS_KCONFIG)"
config ZEPHYR_CMSIS_MODULE
	bool
	default y
endmenu
menu "cmsis-dsp (D:/aguat/Documents/zephyr/zephyr_main/modules/lib/cmsis-dsp)"
osource "$(ZEPHYR_CMSIS_DSP_KCONFIG)"
config ZEPHYR_CMSIS_DSP_MODULE
	bool
	default y
endmenu
menu "cmsis-nn (D:/aguat/Documents/zephyr/zephyr_main/modules/lib/cmsis-nn)"
osource "$(ZEPHYR_CMSIS_NN_KCONFIG)"
config ZEPHYR_CMSIS_NN_MODULE
	bool
	default y
endmenu
menu "cmsis_6 (D:/aguat/Documents/zephyr/zephyr_main/modules/hal/cmsis_6)"
osource "$(ZEPHYR_CMSIS_6_KCONFIG)"
config ZEPHYR_CMSIS_6_MODULE
	bool
	default y
endmenu
menu "fatfs (D:/aguat/Documents/zephyr/zephyr_main/modules/fs/fatfs)"
osource "$(ZEPHYR_FATFS_KCONFIG)"
config ZEPHYR_FATFS_MODULE
	bool
	default y
endmenu
config ZEPHYR_ADI_MODULE
	bool
	default y
menu "hal_afbr (D:/aguat/Documents/zephyr/zephyr_main/modules/hal/afbr)"
osource "$(ZEPHYR_HAL_AFBR_KCONFIG)"
config ZEPHYR_HAL_AFBR_MODULE
	bool
	default y
	select TAINT_BLOBS

config ZEPHYR_HAL_AFBR_MODULE_BLOBS
	bool
	default y
endmenu
menu "hal_ambiq (D:/aguat/Documents/zephyr/zephyr_main/modules/hal/ambiq)"
osource "$(ZEPHYR_HAL_AMBIQ_KCONFIG)"
config ZEPHYR_HAL_AMBIQ_MODULE
	bool
	default y
endmenu
config ZEPHYR_ATMEL_MODULE
	bool
	default y
menu "hal_bouffalolab (D:/aguat/Documents/zephyr/zephyr_main/modules/hal/bouffalolab)"
osource "$(ZEPHYR_HAL_BOUFFALOLAB_KCONFIG)"
config ZEPHYR_HAL_BOUFFALOLAB_MODULE
	bool
	default y
endmenu
menu "hal_espressif (D:/aguat/Documents/zephyr/zephyr_main/modules/hal/espressif)"
osource "D:/aguat/Documents/zephyr/zephyr_main/modules/hal/espressif/zephyr/Kconfig"
config ZEPHYR_HAL_ESPRESSIF_MODULE
	bool
	default y
	select TAINT_BLOBS

config ZEPHYR_HAL_ESPRESSIF_MODULE_BLOBS
	bool
	default y
endmenu
menu "hal_ethos_u (D:/aguat/Documents/zephyr/zephyr_main/modules/hal/ethos_u)"
osource "$(ZEPHYR_HAL_ETHOS_U_KCONFIG)"
config ZEPHYR_HAL_ETHOS_U_MODULE
	bool
	default y
endmenu
menu "hal_gigadevice (D:/aguat/Documents/zephyr/zephyr_main/modules/hal/gigadevice)"
osource "$(ZEPHYR_HAL_GIGADEVICE_KCONFIG)"
config ZEPHYR_HAL_GIGADEVICE_MODULE
	bool
	default y
endmenu
menu "hal_infineon (D:/aguat/Documents/zephyr/zephyr_main/modules/hal/infineon)"
osource "$(ZEPHYR_HAL_INFINEON_KCONFIG)"
config ZEPHYR_HAL_INFINEON_MODULE
	bool
	default y
	select TAINT_BLOBS

config ZEPHYR_HAL_INFINEON_MODULE_BLOBS
	bool
	default y
endmenu
menu "hal_intel (D:/aguat/Documents/zephyr/zephyr_main/modules/hal/intel)"
osource "D:/aguat/Documents/zephyr/zephyr_main/modules/hal/intel/zephyr/Kconfig"
config ZEPHYR_HAL_INTEL_MODULE
	bool
	default y
endmenu
config ZEPHYR_MICROCHIP_MODULE
	bool
	default y
menu "hal_nordic (D:/aguat/Documents/zephyr/zephyr_main/modules/hal/nordic)"
osource "$(ZEPHYR_HAL_NORDIC_KCONFIG)"
config ZEPHYR_HAL_NORDIC_MODULE
	bool
	default y
	select TAINT_BLOBS

config ZEPHYR_HAL_NORDIC_MODULE_BLOBS
	bool
	default y
endmenu
config ZEPHYR_NUVOTON_MODULE
	bool
	default y
menu "hal_nxp (D:/aguat/Documents/zephyr/zephyr_main/modules/hal/nxp)"
osource "$(ZEPHYR_HAL_NXP_KCONFIG)"
config ZEPHYR_HAL_NXP_MODULE
	bool
	default y
	select TAINT_BLOBS

config ZEPHYR_HAL_NXP_MODULE_BLOBS
	bool
	default y
endmenu
config ZEPHYR_OPENISA_MODULE
	bool
	default y
config ZEPHYR_QUICKLOGIC_MODULE
	bool
	default y
config ZEPHYR_HAL_RENESAS_MODULE
	bool
	default y
	select TAINT_BLOBS

config ZEPHYR_HAL_RENESAS_MODULE_BLOBS
	bool
	default y
menu "hal_rpi_pico (D:/aguat/Documents/zephyr/zephyr_main/modules/hal/rpi_pico)"
osource "$(ZEPHYR_HAL_RPI_PICO_KCONFIG)"
config ZEPHYR_HAL_RPI_PICO_MODULE
	bool
	default y
endmenu
menu "hal_silabs (D:/aguat/Documents/zephyr/zephyr_main/modules/hal/silabs)"
osource "$(ZEPHYR_HAL_SILABS_KCONFIG)"
config ZEPHYR_HAL_SILABS_MODULE
	bool
	default y
	select TAINT_BLOBS

config ZEPHYR_HAL_SILABS_MODULE_BLOBS
	bool
	default y
endmenu
menu "hal_st (D:/aguat/Documents/zephyr/zephyr_main/modules/hal/st)"
osource "$(ZEPHYR_HAL_ST_KCONFIG)"
config ZEPHYR_HAL_ST_MODULE
	bool
	default y
endmenu
config ZEPHYR_HAL_STM32_MODULE
	bool
	default y
	select TAINT_BLOBS

config ZEPHYR_HAL_STM32_MODULE_BLOBS
	bool
	default y
menu "hal_tdk (D:/aguat/Documents/zephyr/zephyr_main/modules/hal/tdk)"
osource "$(ZEPHYR_HAL_TDK_KCONFIG)"
config ZEPHYR_HAL_TDK_MODULE
	bool
	default y
endmenu
menu "hal_telink (D:/aguat/Documents/zephyr/zephyr_main/modules/hal/telink)"
osource "D:/aguat/Documents/zephyr/zephyr_main/modules/hal/telink/Kconfig"
config ZEPHYR_HAL_TELINK_MODULE
	bool
	default y
endmenu
config ZEPHYR_TI_MODULE
	bool
	default y
menu "hal_wch (D:/aguat/Documents/zephyr/zephyr_main/modules/hal/wch)"
osource "$(ZEPHYR_HAL_WCH_KCONFIG)"
config ZEPHYR_HAL_WCH_MODULE
	bool
	default y
endmenu
config ZEPHYR_HAL_WURTHELEKTRONIK_MODULE
	bool
	default y
config ZEPHYR_XTENSA_MODULE
	bool
	default y
menu "hostap (D:/aguat/Documents/zephyr/zephyr_main/modules/lib/hostap)"
osource "$(ZEPHYR_HOSTAP_KCONFIG)"
config ZEPHYR_HOSTAP_MODULE
	bool
	default y
endmenu
menu "liblc3 (D:/aguat/Documents/zephyr/zephyr_main/modules/lib/liblc3)"
osource "$(ZEPHYR_LIBLC3_KCONFIG)"
config ZEPHYR_LIBLC3_MODULE
	bool
	default y
endmenu
config ZEPHYR_LIBMCTP_MODULE
	bool
	default y
config ZEPHYR_LIBMETAL_MODULE
	bool
	default y
menu "littlefs (D:/aguat/Documents/zephyr/zephyr_main/modules/fs/littlefs)"
osource "$(ZEPHYR_LITTLEFS_KCONFIG)"
config ZEPHYR_LITTLEFS_MODULE
	bool
	default y
endmenu
menu "loramac-node (D:/aguat/Documents/zephyr/zephyr_main/modules/lib/loramac-node)"
osource "$(ZEPHYR_LORAMAC_NODE_KCONFIG)"
config ZEPHYR_LORAMAC_NODE_MODULE
	bool
	default y
endmenu
menu "lvgl (D:/aguat/Documents/zephyr/zephyr_main/modules/lib/gui/lvgl)"
osource "D:/aguat/Documents/zephyr/zephyr_main/modules/lib/gui/lvgl/zephyr/Kconfig"
config ZEPHYR_LVGL_MODULE
	bool
	default y
endmenu
menu "mbedtls (D:/aguat/Documents/zephyr/zephyr_main/modules/crypto/mbedtls)"
osource "$(ZEPHYR_MBEDTLS_KCONFIG)"
config ZEPHYR_MBEDTLS_MODULE
	bool
	default y
endmenu
config ZEPHYR_MCUBOOT_MODULE
	bool
	default y
config ZEPHYR_MIPI_SYS_T_MODULE
	bool
	default y
menu "nrf_wifi (D:/aguat/Documents/zephyr/zephyr_main/modules/lib/nrf_wifi)"
osource "$(ZEPHYR_NRF_WIFI_KCONFIG)"
config ZEPHYR_NRF_WIFI_MODULE
	bool
	default y
	select TAINT_BLOBS

config ZEPHYR_NRF_WIFI_MODULE_BLOBS
	bool
	default y
endmenu
config ZEPHYR_OPEN_AMP_MODULE
	bool
	default y
menu "openthread (D:/aguat/Documents/zephyr/zephyr_main/modules/lib/openthread)"
osource "$(ZEPHYR_OPENTHREAD_KCONFIG)"
config ZEPHYR_OPENTHREAD_MODULE
	bool
	default y
endmenu
menu "percepio (D:/aguat/Documents/zephyr/zephyr_main/modules/debug/percepio)"
osource "D:/aguat/Documents/zephyr/zephyr_main/modules/debug/percepio/zephyr/Kconfig"
config ZEPHYR_PERCEPIO_MODULE
	bool
	default y
endmenu
menu "picolibc (D:/aguat/Documents/zephyr/zephyr_main/modules/lib/picolibc)"
osource "D:/aguat/Documents/zephyr/zephyr_main/modules/lib/picolibc/zephyr/Kconfig"
config ZEPHYR_PICOLIBC_MODULE
	bool
	default y
endmenu
menu "segger (D:/aguat/Documents/zephyr/zephyr_main/modules/debug/segger)"
osource "$(ZEPHYR_SEGGER_KCONFIG)"
config ZEPHYR_SEGGER_MODULE
	bool
	default y
endmenu
config ZEPHYR_TINYCRYPT_MODULE
	bool
	default y
menu "trusted-firmware-a (D:/aguat/Documents/zephyr/zephyr_main/modules/tee/tf-a/trusted-firmware-a)"
osource "$(ZEPHYR_TRUSTED_FIRMWARE_A_KCONFIG)"
config ZEPHYR_TRUSTED_FIRMWARE_A_MODULE
	bool
	default y
endmenu
menu "trusted-firmware-m (D:/aguat/Documents/zephyr/zephyr_main/modules/tee/tf-m/trusted-firmware-m)"
osource "$(ZEPHYR_TRUSTED_FIRMWARE_M_KCONFIG)"
config ZEPHYR_TRUSTED_FIRMWARE_M_MODULE
	bool
	default y
endmenu
menu "uoscore-uedhoc (D:/aguat/Documents/zephyr/zephyr_main/modules/lib/uoscore-uedhoc)"
osource "$(ZEPHYR_UOSCORE_UEDHOC_KCONFIG)"
config ZEPHYR_UOSCORE_UEDHOC_MODULE
	bool
	default y
endmenu
menu "zcbor (D:/aguat/Documents/zephyr/zephyr_main/modules/lib/zcbor)"
osource "$(ZEPHYR_ZCBOR_KCONFIG)"
config ZEPHYR_ZCBOR_MODULE
	bool
	default y
endmenu
config ZEPHYR_NRF_HW_MODELS_MODULE
	bool
	default y
```
